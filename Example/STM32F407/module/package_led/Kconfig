## Example/nrf52833DK/app/package_ble_led_ctrl_service/Kconfig
```kconfig
config PACKAGE_BLE_LED_CTRL_SERVICE
	bool "Enable BLE LED control GATT service (LED3 / LED4)"
	default n
	depends on BT
	depends on BT_PERIPHERAL
	depends on PACKAGE_BLE_CORE
	depends on PACKAGE_BLE_CONN
	depends on PACKAGE_LED
	help
	  Registers a custom GATT service that lets a BLE Central (phone / app)
	  read and write the state of LED3 and LED4 on the nRF52833DK board.
	  Each LED has its own characteristic:
	    Write 0x00 -> LED OFF
	    Write 0x01 -> LED ON
	    Read       -> returns current LED state (0x00 or 0x01)
	    Notify     -> pushes state change to subscribed Centrals
	  The service depends on package_led (hardware driver) and
	  package_ble_conn (for connection event callbacks).

if PACKAGE_BLE_LED_CTRL_SERVICE

config PACKAGE_BLE_LED_CTRL_SERVICE_INIT_PRIORITY
	int "BLE LED control service SYS_INIT priority"
	default 97
	help
	  Must be greater than PACKAGE_BLE_CONN_INIT_PRIORITY (default 93)
	  and PACKAGE_LED_INIT_PRIORITY (default 90).

endif # PACKAGE_BLE_LED_CTRL_SERVICE
```

## Example/nrf52833DK/app/package_ble_scan_conn_demo/Kconfig
```kconfig
config PACKAGE_BLE_SCAN_CONN_DEMO
	bool "Enable BLE scan and connection demo"
	default y
	depends on BT
	depends on BT_CENTRAL
	help
	  Enable a minimal BLE central-role demo for learning.
	  The demo scans for a target device by name, connects to it, and
	  automatically reconnects whenever the connection is dropped.

if PACKAGE_BLE_SCAN_CONN_DEMO

config PACKAGE_BLE_SCAN_CONN_DEMO_INIT_PRIORITY
	int "BLE scan/connection demo init priority"
	default 91
	help
	  Initialization priority for starting BLE scanning.
	  Must be higher (larger number) than the Bluetooth stack init (90)
	  so that bt_enable() has already completed when this module runs.

endif # PACKAGE_BLE_SCAN_CONN_DEMO
```

## Example/nrf52833DK/app/package_event/Kconfig
```kconfig
config PACKAGE_EVENT_DEMO
	bool "Enable event learning demo"
	default y
	help
	  Enable a minimal Zephyr k_event demo.
	  The demo shows how one thread waits on a combination of event bits
	  while two other threads independently post different bits, so you
	  can observe both "wait for any" and "wait for all" behavior.

if PACKAGE_EVENT_DEMO

config PACKAGE_EVENT_DEMO_STACK_SIZE
	int "Event demo thread stack size (bytes)"
	default 1024
	help
	  Stack size shared by the waiter and the two poster threads.

config PACKAGE_EVENT_DEMO_WAITER_PRIORITY
	int "Event demo waiter thread priority"
	default 7
	help
	  Zephyr thread priority for the waiter thread (lower number = higher priority).

config PACKAGE_EVENT_DEMO_POSTER_PRIORITY
	int "Event demo poster threads priority"
	default 8
	help
	  Zephyr thread priority shared by both poster threads.
	  Should be lower priority (higher number) than the waiter so the
	  waiter is ready to block before the first event is posted.

endif # PACKAGE_EVENT_DEMO
```

## Example/nrf52833DK/app/package_fifo/Kconfig
```kconfig
config PACKAGE_FIFO_DEMO
	bool "Enable FIFO learning demo"
	default y
	help
	  Enable a minimal Zephyr k_fifo demo.
	  The demo shows how a producer thread allocates data items and pushes
	  them into a FIFO, while a consumer thread waits on the FIFO and pops
	  the items out in first-in-first-out order.

if PACKAGE_FIFO_DEMO

config PACKAGE_FIFO_DEMO_STACK_SIZE
	int "FIFO demo thread stack size (bytes)"
	default 1024
	help
	  Stack size shared by both the consumer and producer threads.

config PACKAGE_FIFO_DEMO_CONSUMER_PRIORITY
	int "FIFO demo consumer thread priority"
	default 7
	help
	  Zephyr thread priority for the consumer thread (lower number = higher priority).

config PACKAGE_FIFO_DEMO_PRODUCER_PRIORITY
	int "FIFO demo producer thread priority"
	default 8
	help
	  Zephyr thread priority for the producer thread.
	  Should be lower priority (higher number) than the consumer so the
	  consumer is ready to block before the first item arrives.

endif # PACKAGE_FIFO_DEMO
```

## Example/nrf52833DK/app/package_gatt_server_demo/Kconfig
```kconfig
config PACKAGE_GATT_SERVER_DEMO
	bool "Enable BLE GATT server demo (Peripheral + GATT Server role)"
	default n
	depends on BT
	depends on BT_PERIPHERAL
	help
	  Enable a BLE GATT server demo for learning ATT/GATT concepts.
	  The demo defines a custom 128-bit service with three characteristics
	  that demonstrate every fundamental ATT operation:
	    - Firmware Version  (Read-only)
	    - LED Control       (Read / Write)
	    - Counter           (Read / Notify — increments every second)
	  Only one BLE demo should be enabled at a time because each calls
	  bt_enable(). Disable PACKAGE_BLE_SCAN_CONN_DEMO before enabling this.

if PACKAGE_GATT_SERVER_DEMO

config PACKAGE_GATT_SERVER_DEMO_INIT_PRIORITY
	int "GATT server demo SYS_INIT priority"
	default 90
	help
	  SYS_INIT priority for this module. Must be >= 90 so it runs after
	  the Bluetooth controller driver is registered.

config PACKAGE_GATT_SERVER_DEMO_STACK_SIZE
	int "Notification thread stack size (bytes)"
	default 1024
	help
	  Stack size for the counter notification thread.

config PACKAGE_GATT_SERVER_DEMO_THREAD_PRIORITY
	int "Notification thread priority"
	default 7
	help
	  Cooperative or preemptive priority of the notification thread.
	  Must be lower priority (higher number) than the BT RX work queue.

config PACKAGE_GATT_SERVER_DEMO_NOTIFY_INTERVAL_MS
	int "Counter notification interval (milliseconds)"
	default 1000
	help
	  How often the counter characteristic value is incremented and a
	  GATT notification is sent to subscribed centrals.

endif # PACKAGE_GATT_SERVER_DEMO
```

## Example/nrf52833DK/app/package_kmsq/Kconfig
```kconfig
config PACKAGE_KMSQ_DEMO
	bool "Enable message queue learning demo"
	default y
	help
	  Enable a minimal Zephyr message queue (k_msgq) demo.
	  The demo shows how a producer thread enqueues structured messages and
	  a consumer thread dequeues and processes them, including blocking
	  behaviour when the queue is full or empty.
```

## Example/nrf52833DK/app/package_kmutex/Kconfig
```kconfig
config PACKAGE_KMUTEX_DEMO
	bool "Enable mutex learning demo"
	default y
	help
	  Enable a minimal Zephyr mutex (k_mutex) demo.
	  The demo shows how two threads compete for a shared resource and how
	  k_mutex guarantees that only one thread accesses the resource at a time,
	  preventing data races and demonstrating priority inheritance.

if PACKAGE_KMUTEX_DEMO

config PACKAGE_KMUTEX_DEMO_STACK_SIZE
	int "Mutex demo thread stack size (bytes)"
	default 1024
	help
	  Stack size shared by both Thread A and Thread B.

config PACKAGE_KMUTEX_DEMO_THREAD_A_PRIORITY
	int "Mutex demo Thread A priority (high-priority thread)"
	default 6
	help
	  Zephyr thread priority for Thread A.  Lower number means higher priority.
	  Thread A is the high-priority contender; when it waits for the mutex held
	  by Thread B, the kernel elevates Thread B to this priority (priority
	  inheritance) to avoid priority inversion.

config PACKAGE_KMUTEX_DEMO_THREAD_B_PRIORITY
	int "Mutex demo Thread B priority (low-priority thread)"
	default 8
	help
	  Zephyr thread priority for Thread B.
	  Must be numerically larger (lower priority) than THREAD_A_PRIORITY so
	  that the priority-inheritance effect is observable in the logs.

endif # PACKAGE_KMUTEX_DEMO
```
