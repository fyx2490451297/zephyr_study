## Example/STM32F407/module/package_led/Kconfig
```kconfig
menu "LED Package Configuration"

config PACKAGE_LED
    bool "Enable System Status LED Module"
    default y
    help
      开启此选项以将 LED 模块编译进内核。

config PACKAGE_LED_AUTO_BLINK
    bool "Enable Auto Blinking in Background"
    default y
    depends on PACKAGE_LED
    help
      如果开启，LED 模块将在后台自动闪烁，不阻塞主线程。

config PACKAGE_LED_BLINK_INTERVAL
    int "LED Blink Interval (ms)"
    default 500
    depends on PACKAGE_LED_AUTO_BLINK
    help
      设置自动闪烁的间隔时间（毫秒）。

endmenu
```

## Example/nrf52833DK-pendant/Kconfig
```kconfig
mainmenu "nrf52833DK project Configuration"

# Hardware package configurations
rsource "hardware/package_led/Kconfig"
rsource "hardware/package_rs485/Kconfig"
rsource "hardware/package_display/Kconfig"

# Application module configurations
rsource "app/package_lvgl_demo/Kconfig"
rsource "app/package_rs485_demo/Kconfig"

# include the default Zephyr configuration (required)
source "Kconfig.zephyr"
```

## Example/nrf52833DK-pendant/app/package_lvgl_demo/Kconfig
```kconfig
config PACKAGE_LVGL_DEMO
	bool "Enable LVGL demo application module"
	default n
	depends on LVGL
	depends on DISPLAY
	help
	  Simple LVGL demo that draws a title label and a periodically
	  updated uptime counter on the ILI9341 display. Used to validate the
	  SPI1 devicetree wiring and the LVGL/display Kconfig configuration.

if PACKAGE_LVGL_DEMO

config PACKAGE_LVGL_DEMO_STACK_SIZE
	int "LVGL demo thread stack size (bytes)"
	default 4096
	help
	  LVGL rendering needs a sizeable stack for its internal draw buffers
	  and call chains.

config PACKAGE_LVGL_DEMO_PRIORITY
	int "LVGL demo thread priority"
	default 7

config PACKAGE_LVGL_DEMO_REFRESH_MS
	int "LVGL demo refresh period (ms)"
	default 30
	help
	  Upper bound on how often lv_timer_handler() is invoked from the
	  demo thread loop.

endif # PACKAGE_LVGL_DEMO
```

## Example/nrf52833DK-pendant/app/package_rs485_demo/Kconfig
```kconfig
config PACKAGE_RS485_DEMO
	bool "Enable RS485 demo application module"
	default n
	depends on PACKAGE_RS485
	help
	  Demo application that periodically transmits a test frame over the
	  RS485 bus and logs any bytes received back. Used to validate the
	  UART1 + DE/RE devicetree wiring and the package_rs485 driver.

if PACKAGE_RS485_DEMO

config PACKAGE_RS485_DEMO_STACK_SIZE
	int "RS485 demo thread stack size (bytes)"
	default 1024

config PACKAGE_RS485_DEMO_PRIORITY
	int "RS485 demo thread priority"
	default 7

config PACKAGE_RS485_DEMO_PERIOD_MS
	int "RS485 demo send period (ms)"
	default 1000
	help
	  Interval between two consecutive test frame transmissions.

endif # PACKAGE_RS485_DEMO
```

## Example/nrf52833DK-pendant/hardware/package_display/Kconfig
```kconfig
config PACKAGE_DISPLAY
	bool "Enable display hardware package (zephyr,display chosen)"
	default n
	depends on DISPLAY
	help
	  Thin wrapper around the devicetree "zephyr,display" chosen node.
	  This package owns the concrete display IC (ILI9341, ...) so that
	  upper layers (LVGL port, UI) never need to reference a specific
	  panel driver or its devicetree node directly.

if PACKAGE_DISPLAY

config PACKAGE_DISPLAY_INIT_PRIORITY
	int "Display driver init priority"
	default 90
	help
	  Initialization priority for the display package at APPLICATION
	  level. Must run before any thread that calls display_power_on().

endif # PACKAGE_DISPLAY
```

## Example/nrf52833DK-pendant/hardware/package_rs485/Kconfig
```kconfig
config PACKAGE_RS485
	bool "Enable RS485 hardware package (UART1 + DE/RE direction control)"
	default n
	depends on SERIAL
	depends on UART_INTERRUPT_DRIVEN
	depends on GPIO
	help
	  Enable half-duplex RS485 transport over UART1. This package owns the
	  UART1 RX/TX FIFOs and drives the external transceiver's DE/RE pin
	  (rs485-de-gpios under /zephyr,user in device tree) so the driver
	  output is only enabled while a frame is being transmitted, and the
	  bus falls back to receive mode the rest of the time.

if PACKAGE_RS485

config PACKAGE_RS485_INIT_PRIORITY
	int "RS485 driver init priority"
	default 91
	help
	  Initialization priority for the RS485 driver at APPLICATION level.

config PACKAGE_RS485_TX_BUFFER_SIZE
	int "RS485 TX staging buffer size (bytes)"
	default 256
	range 16 2048
	help
	  Maximum frame size that can be passed to rs485_send() in one call.

config PACKAGE_RS485_RX_RING_BUFFER_SIZE
	int "RS485 RX ring buffer size (bytes)"
	default 256
	range 64 4096
	help
	  Ring buffer size used to cache UART RX bytes before upper-layer
	  consumption.

config PACKAGE_RS485_RX_THREAD_STACK_SIZE
	int "RS485 RX thread stack size (bytes)"
	default 1024

config PACKAGE_RS485_RX_THREAD_PRIORITY
	int "RS485 RX thread priority"
	default 7

config PACKAGE_RS485_TX_TIMEOUT_MS
	int "RS485 TX completion wait timeout (ms)"
	default 200
	help
	  Maximum time rs485_send() waits for the UART shift register to
	  finish draining before giving up and forcing the transceiver back
	  to receive mode.

endif # PACKAGE_RS485
```

## Example/nrf52833DK-zephyr-only/app/package_kmsq/Kconfig
```kconfig
config PACKAGE_KMSQ_DEMO
	bool "Enable message queue learning demo"
	default y
	help
	  Enable a minimal Zephyr message queue (k_msgq) demo.
	  The demo shows how a producer thread enqueues structured messages and
	  a consumer thread dequeues and processes them, including blocking
	  behaviour when the queue is full or empty.

if PACKAGE_KMSQ_DEMO

config PACKAGE_KMSQ_DEMO_STACK_SIZE
	int "Message queue demo thread stack size (bytes)"
	default 1024
	help
	  Stack size shared by both the producer and consumer threads.

config PACKAGE_KMSQ_DEMO_PRODUCER_PRIORITY
	int "Message queue demo producer thread priority"
	default 8
	help
	  Zephyr thread priority for the producer thread.

config PACKAGE_KMSQ_DEMO_CONSUMER_PRIORITY
	int "Message queue demo consumer thread priority"
	default 9
	help
	  Zephyr thread priority for the consumer thread.
	  Set slightly lower than the producer so the producer runs first when
	  both are ready; this makes the queue fill-up behaviour easier to observe.

endif # PACKAGE_KMSQ_DEMO
```

## Example/nrf52833DK/Kconfig
```kconfig
mainmenu "nrf52833DK project Configuration"

# Hardware package configurations
rsource "hardware/package_led/Kconfig"
rsource "hardware/package_key/Kconfig"
rsource "hardware/package_lcd_backlight/Kconfig"

# Application module configurations
rsource "app/package_led_ctrl/Kconfig"
rsource "app/package_ble_adv_demo/Kconfig"
rsource "app/package_adv_conn_demo/Kconfig"
rsource "app/package_ble_scan_conn_demo/Kconfig"
rsource "app/package_mcu_transport/Kconfig"
rsource "app/package_sem/Kconfig"
rsource "app/package_fifo/Kconfig"
rsource "app/package_event/Kconfig"
rsource "app/package_work_queue/Kconfig"
rsource "app/package_poll/Kconfig"
rsource "app/package_kmsq/Kconfig"
rsource "app/package_kmutex/Kconfig"
rsource "app/package_atomic/Kconfig"
rsource "app/package_spinlock/Kconfig"
rsource "app/package_gatt_server_demo/Kconfig"
rsource "app/package_lcd_ui/Kconfig"
rsource "app/package_sys_monitor/Kconfig"

# BLE OTA production packages
rsource "app/package_ble_core/Kconfig"
rsource "app/package_ble_adv/Kconfig"
rsource "app/package_ble_conn/Kconfig"
rsource "app/package_ble_gatt_service/Kconfig"
rsource "app/package_ble_gatt_ota_service/Kconfig"
rsource "app/package_ble_gatt_client/Kconfig"
rsource "app/package_ble_led_ctrl_service/Kconfig"

# include the default Zephyr configuration (required)
source "Kconfig.zephyr"
```

## Example/nrf52833DK/app/package_adv_conn_demo/Kconfig
```kconfig
config PACKAGE_ADV_CONN_DEMO
	bool "Enable BLE advertising + connection demo (Peripheral role)"
	default n
	depends on BT
	depends on BT_PERIPHERAL
	help
	  Enable a BLE Peripheral-role demo for learning.
	  The demo initialises the Bluetooth stack, starts advertising, and
	  handles the full connection lifecycle:
	    advertise -> connected -> param update -> disconnected -> re-advertise.
	  Only one BLE demo should be enabled at a time (each calls bt_enable()).

if PACKAGE_ADV_CONN_DEMO

config PACKAGE_ADV_CONN_DEMO_INIT_PRIORITY
	int "BLE adv/connection demo init priority"
	default 90
	help
	  SYS_INIT priority for this module. Must be >= 90 to run after the
	  Bluetooth controller driver has been registered.

endif # PACKAGE_ADV_CONN_DEMO
```

## Example/nrf52833DK/app/package_atomic/Kconfig
```kconfig
config PACKAGE_ATOMIC_DEMO
	bool "Enable atomic operations learning demo"
	default y
	help
	  Enable a minimal Zephyr atomic (atomic_t) demo.
	  The demo shows two worker threads updating a shared counter and a
	  shared bitmask with lock-free atomic operations (atomic_inc,
	  atomic_dec, atomic_cas, atomic_set_bit/atomic_clear_bit), instead of
	  guarding the shared state with a mutex or semaphore.

if PACKAGE_ATOMIC_DEMO

config PACKAGE_ATOMIC_DEMO_STACK_SIZE
	int "Atomic demo thread stack size (bytes)"
	default 1024
	help
	  Stack size shared by both worker threads.

config PACKAGE_ATOMIC_DEMO_INCREMENTER_PRIORITY
	int "Atomic demo incrementer thread priority"
	default 8
	help
	  Zephyr thread priority for the thread that increments the shared
	  counter and sets bits in the shared bitmask.

config PACKAGE_ATOMIC_DEMO_DECREMENTER_PRIORITY
	int "Atomic demo decrementer thread priority"
	default 8
	help
	  Zephyr thread priority for the thread that decrements the shared
	  counter and clears bits in the shared bitmask.
	  Kept equal to the incrementer priority so the scheduler interleaves
	  both threads, making the lock-free updates race in practice.

endif # PACKAGE_ATOMIC_DEMO
```

## Example/nrf52833DK/app/package_ble_adv/Kconfig
```kconfig
config PACKAGE_BLE_ADV
	bool "Enable BLE advertising manager"
	default n
	depends on BT
	depends on BT_PERIPHERAL
	depends on PACKAGE_BLE_CORE
	help
	  Manages BLE connectable advertising.  Starts advertising automatically
	  on init and exposes ble_adv_start() / ble_adv_stop() so the connection
	  manager (package_ble_conn) can re-start advertising after disconnect.

if PACKAGE_BLE_ADV

config PACKAGE_BLE_ADV_INIT_PRIORITY
	int "BLE advertising manager SYS_INIT priority"
	default 91
	help
	  Must be greater than PACKAGE_BLE_CORE_INIT_PRIORITY (default 90) so
	  the stack is ready before advertising is started.

endif # PACKAGE_BLE_ADV
```

## Example/nrf52833DK/app/package_ble_conn/Kconfig
```kconfig
config PACKAGE_BLE_CONN
	bool "Enable BLE connection manager"
	default n
	depends on BT
	depends on BT_PERIPHERAL
	depends on PACKAGE_BLE_CORE
	depends on PACKAGE_BLE_ADV
	help
	  Centralises BLE connection lifecycle management.  Registers the
	  BT_CONN_CB callbacks (connected / disconnected) and dispatches events
	  to all modules that register via ble_conn_register_event_cb().
	  Automatically restarts advertising (via ble_adv_start) on disconnect.

if PACKAGE_BLE_CONN

config PACKAGE_BLE_CONN_INIT_PRIORITY
	int "BLE connection manager SYS_INIT priority"
	default 93
	help
	  Must be greater than PACKAGE_BLE_ADV_INIT_PRIORITY (default 91) and
	  PACKAGE_MCU_TRANSPORT_INIT_PRIORITY (default 92).

config PACKAGE_BLE_CONN_MAX_EVENT_CBS
	int "Maximum number of registered connection event callbacks"
	default 4
	range 1 16
	help
	  Static pool size for ble_conn_register_event_cb().  Each BLE package
	  that needs connection events (e.g. ble_gatt_ota_service) consumes one
	  slot.

endif # PACKAGE_BLE_CONN
```

## Example/nrf52833DK/app/package_ble_core/Kconfig
```kconfig
config PACKAGE_BLE_CORE
	bool "Enable BLE core (Bluetooth stack initialisation)"
	default n
	depends on BT
	help
	  Initialises the Zephyr Bluetooth Host + Controller stack with
	  bt_enable() once at APPLICATION boot.  All other BLE packages
	  (ble_adv, ble_conn, gatt services) depend on this package and
	  must have a higher SYS_INIT priority number so they run after
	  ble_core_init() completes.
	  Only one package may call bt_enable(); enable this package instead
	  of the individual demo modules (package_ble_adv_demo, etc.).

if PACKAGE_BLE_CORE

config PACKAGE_BLE_CORE_INIT_PRIORITY
	int "BLE core SYS_INIT priority"
	default 90
	help
	  SYS_INIT priority for ble_core_init().  Must be lower than all
	  other BLE package priorities so the stack is ready before they run.

endif # PACKAGE_BLE_CORE
```

## Example/nrf52833DK/app/package_ble_demo/Kconfig
```kconfig
config PACKAGE_BLE_DEMO
	bool "Enable BLE advertising demo"
	default y
	depends on BT
	help
	  Enable a minimal BLE advertising demo for learning.
	  The demo starts Bluetooth and begins advertising at boot.

if PACKAGE_BLE_DEMO

config PACKAGE_BLE_DEMO_INIT_PRIORITY
	int "BLE demo init priority"
	default 90
	help
	  Initialization priority for starting BLE advertising.

endif # PACKAGE_BLE_DEMO
```

## Example/nrf52833DK/app/package_ble_gatt_client/Kconfig
```kconfig
config PACKAGE_BLE_GATT_CLIENT
	bool "Enable BLE GATT client"
	default n
	depends on BT
	depends on BT_CENTRAL
	depends on PACKAGE_BLE_CORE
	depends on PACKAGE_BLE_CONN
	help
	  Provides a simple GATT client API for when the nRF52833 acts in the
	  Central role: service discovery, characteristic discovery, read,
	  write (with and without response), and notification subscription.
	  All operations are asynchronous (callback-based) and serialised —
	  only one operation of each type may be in flight at a time.

if PACKAGE_BLE_GATT_CLIENT

config PACKAGE_BLE_GATT_CLIENT_INIT_PRIORITY
	int "BLE GATT client SYS_INIT priority"
	default 96
	help
	  Must be greater than PACKAGE_BLE_CONN_INIT_PRIORITY (default 93).

config PACKAGE_BLE_GATT_CLIENT_MAX_SUBSCRIPTIONS
	int "Maximum simultaneous GATT notification subscriptions"
	default 4
	range 1 16
	help
	  Static pool size for bt_gatt_subscribe_params structs.  Each active
	  subscription (enabled CCC) consumes one slot.  Subscribe calls fail
	  with -ENOMEM when the pool is exhausted.

endif # PACKAGE_BLE_GATT_CLIENT
```

## Example/nrf52833DK/app/package_ble_gatt_service/Kconfig
```kconfig
config PACKAGE_BLE_GATT_SERVICE
	bool "Enable BLE GATT common service (Device Information Service)"
	default n
	depends on BT
	depends on PACKAGE_BLE_CORE
	help
	  Registers a standard Bluetooth SIG Device Information Service (DIS,
	  UUID 0x180A) with three read-only characteristics:
	    Manufacturer Name String  (0x2A29)
	    Model Number String       (0x2A24)
	    Firmware Revision String  (0x2A26)
	  The service is defined via BT_GATT_SERVICE_DEFINE (static, no runtime
	  call needed).  String values are configured via Kconfig.

if PACKAGE_BLE_GATT_SERVICE

config PACKAGE_BLE_GATT_SERVICE_INIT_PRIORITY
	int "BLE GATT service SYS_INIT priority"
	default 94

config PACKAGE_BLE_GATT_SERVICE_MANUFACTURER
	string "DIS Manufacturer Name String"
	default "Zephyr Example"
	help
	  Returned for ATT reads on UUID 0x2A29 (Manufacturer Name String).

config PACKAGE_BLE_GATT_SERVICE_MODEL
	string "DIS Model Number String"
	default "nRF52833DK"
	help
	  Returned for ATT reads on UUID 0x2A24 (Model Number String).

config PACKAGE_BLE_GATT_SERVICE_FW_REV
	string "DIS Firmware Revision String"
	default "0.1.0"
	help
	  Returned for ATT reads on UUID 0x2A26 (Firmware Revision String).

endif # PACKAGE_BLE_GATT_SERVICE
```
