## Example/nrf52833DK/app/package_lcd_ui/Kconfig
```kconfig
config PACKAGE_LCD_UI
	bool "Enable LCD LVGL UI application module"
	default y
	depends on PACKAGE_LCD_BACKLIGHT
	depends on DISPLAY
	depends on LVGL
	help
	  Application-level LVGL UI for the ILI9341 LCD (pipe-bender dashboard,
	  ported from an LVGL v9 PC prototype to LVGL v8 widget/image APIs).
	  Runs display bring-up and the lv_task_handler() loop in a dedicated
	  thread. Depends on the LCD backlight hardware package, the display
	  subsystem, and LVGL.

if PACKAGE_LCD_UI

config PACKAGE_LCD_UI_STACK_SIZE
	int "LCD UI thread stack size (bytes)"
	default 4096
	help
	  Stack size for the LVGL task handler thread. LVGL widget creation
	  and rendering needs more stack than typical demo threads.

config PACKAGE_LCD_UI_PRIORITY
	int "LCD UI thread priority"
	default 7

config PACKAGE_LCD_UI_ASYNC_FLUSH
	bool "Use non-blocking (EasyDMA async) SPI flush for the LCD"
	default y
	depends on SPI_ASYNC
	help
	  Bypass the blocking spi_write() calls made internally by the
	  in-tree mipi_dbi_spi / ILI9341 display drivers when pushing pixel
	  data, and instead drive the SPI bus directly with
	  spi_transceive_cb() against the nRF52833 SPIM/EasyDMA peripheral.
	  lv_disp_flush_ready() is signalled from the SPI completion
	  callback, so the LCD UI thread issues the pixel DMA transfer and
	  returns immediately instead of blocking on it.

endif # PACKAGE_LCD_UI
```

## Example/nrf52833DK/app/package_led_ctrl/Kconfig
```kconfig
config PACKAGE_LED_CTRL
	bool "Enable LED control application module"
	default y
	depends on PACKAGE_LED
	help
	  Application-level LED control logic (blink, patterns, etc.).
	  Depends on the LED hardware package (PACKAGE_LED).

if PACKAGE_LED_CTRL

config PACKAGE_LED_CTRL_STACK_SIZE
	int "LED control thread stack size (bytes)"
	default 1024

config PACKAGE_LED_CTRL_PRIORITY
	int "LED control thread priority"
	default 7

endif # PACKAGE_LED_CTRL
```

## Example/nrf52833DK/app/package_mcu_transport/Kconfig
```kconfig
config PACKAGE_MCU_TRANSPORT
	bool "Enable MCU transport package (UART1)"
	default n
	depends on SERIAL
	depends on UART_INTERRUPT_DRIVEN
	depends on RING_BUFFER
	help
	  Enable UART-based byte-stream transport between BLE side and MCU protocol
	  stack. This package owns UART RX/TX and provides callback-based RX data
	  delivery for upper protocol layers.

if PACKAGE_MCU_TRANSPORT

config PACKAGE_MCU_TRANSPORT_INIT_PRIORITY
	int "MCU transport init priority"
	default 92
	help
	  Initialization priority for mcu transport module at APPLICATION level.

config PACKAGE_MCU_TRANSPORT_RX_RING_BUFFER_SIZE
	int "MCU transport RX ring buffer size (bytes)"
	default 512
	range 64 4096
	help
	  Ring buffer size used to cache UART RX bytes before upper-layer
	  consumption.

config PACKAGE_MCU_TRANSPORT_RX_THREAD_STACK_SIZE
	int "MCU transport RX thread stack size (bytes)"
	default 1024

config PACKAGE_MCU_TRANSPORT_RX_THREAD_PRIORITY
	int "MCU transport RX thread priority"
	default 7

endif # PACKAGE_MCU_TRANSPORT
```

## Example/nrf52833DK/app/package_poll/Kconfig
```kconfig
config PACKAGE_POLL_DEMO
	bool "Enable poll learning demo"
	default y
	help
	  Enable a minimal Zephyr k_poll demo.
	  The demo shows how a single thread can block on MULTIPLE, DIFFERENT
	  kernel objects at once (a semaphore and a poll signal) using k_poll(),
	  and tell which one woke it up.

if PACKAGE_POLL_DEMO

config PACKAGE_POLL_DEMO_STACK_SIZE
	int "Poll demo thread stack size (bytes)"
	default 1024
	help
	  Stack size shared by the poller thread and the two source threads.

config PACKAGE_POLL_DEMO_POLLER_PRIORITY
	int "Poll demo poller thread priority"
	default 7
	help
	  Zephyr thread priority for the poller thread (lower number = higher priority).

config PACKAGE_POLL_DEMO_SOURCE_PRIORITY
	int "Poll demo source threads priority"
	default 8
	help
	  Zephyr thread priority shared by both the semaphore-giver and the
	  signal-raiser threads.
	  Should be lower priority (higher number) than the poller so the
	  poller is ready to block before the first source fires.

endif # PACKAGE_POLL_DEMO
```

## Example/nrf52833DK/app/package_sem/Kconfig
```kconfig
config PACKAGE_SEM_DEMO
	bool "Enable semaphore learning demo"
	default y
	help
	  Enable a minimal Zephyr semaphore demo.
	  The demo shows how one thread waits on a semaphore and another thread
	  periodically gives it.

if PACKAGE_SEM_DEMO

config PACKAGE_SEM_DEMO_STACK_SIZE
	int "Semaphore demo thread stack size (bytes)"
	default 1024
	help
	  Stack size shared by both the consumer and producer threads.

config PACKAGE_SEM_DEMO_CONSUMER_PRIORITY
	int "Semaphore demo consumer thread priority"
	default 7
	help
	  Zephyr thread priority for the consumer thread (lower number = higher priority).

config PACKAGE_SEM_DEMO_PRODUCER_PRIORITY
	int "Semaphore demo producer thread priority"
	default 8
	help
	  Zephyr thread priority for the producer thread.
	  Should be lower priority (higher number) than the consumer so the
	  consumer is ready to block before the first give arrives.

endif # PACKAGE_SEM_DEMO
```

## Example/nrf52833DK/app/package_spinlock/Kconfig
```kconfig
config PACKAGE_SPINLOCK_DEMO
	bool "Enable spinlock learning demo"
	default y
	help
	  Enable a minimal Zephyr spinlock (struct k_spinlock) demo.
	  The demo shows two worker threads and a periodic timer ISR all
	  updating the same shared data structure, protected by a single
	  spinlock. Unlike a mutex, a spinlock may be safely taken from
	  interrupt context (ISR), which this demo also exercises.

if PACKAGE_SPINLOCK_DEMO

config PACKAGE_SPINLOCK_DEMO_STACK_SIZE
	int "Spinlock demo thread stack size (bytes)"
	default 1024
	help
	  Stack size shared by both worker threads.

config PACKAGE_SPINLOCK_DEMO_WRITER_PRIORITY
	int "Spinlock demo writer thread priority"
	default 8
	help
	  Zephyr thread priority for the thread that appends entries to the
	  shared ring-style log under the spinlock.

config PACKAGE_SPINLOCK_DEMO_READER_PRIORITY
	int "Spinlock demo reader thread priority"
	default 8
	help
	  Zephyr thread priority for the thread that reads and clears the
	  shared statistics under the spinlock.
	  Kept equal to the writer priority so the scheduler interleaves both
	  threads, making the critical-section protection easy to observe.

config PACKAGE_SPINLOCK_DEMO_INIT_PRIORITY
	int "Spinlock demo init priority"
	default 90
	help
	  SYS_INIT priority (APPLICATION level) used to start the periodic
	  timer that drives the ISR-context spinlock updates.

endif # PACKAGE_SPINLOCK_DEMO
```

## Example/nrf52833DK/app/package_sys_monitor/Kconfig
```kconfig
config PACKAGE_SYS_MONITOR
	bool "Enable serial FPS/CPU/RAM system monitor module"
	default y
	depends on LVGL
	select SCHED_THREAD_USAGE_ALL
	help
	  Periodically logs the LVGL screen FPS, overall CPU load, and LVGL
	  heap RAM usage over the console UART, for runtime performance
	  monitoring of the pipe-bender LCD UI.

if PACKAGE_SYS_MONITOR

config PACKAGE_SYS_MONITOR_STACK_SIZE
	int "System monitor thread stack size (bytes)"
	default 1024

config PACKAGE_SYS_MONITOR_PRIORITY
	int "System monitor thread priority"
	default 10

config PACKAGE_SYS_MONITOR_PERIOD_MS
	int "Reporting period (milliseconds)"
	default 1000

endif # PACKAGE_SYS_MONITOR
```

## Example/nrf52833DK/app/package_work_queue/Kconfig
```kconfig
config PACKAGE_WORK_QUEUE_DEMO
	bool "Enable work queue learning demo"
	default y
	help
	  Enable a minimal Zephyr work queue demo.
	  The demo creates a dedicated (custom) workqueue thread, submits a
	  one-shot k_work item from a trigger thread, and schedules a
	  self-resubmitting k_work_delayable item to show periodic work.

if PACKAGE_WORK_QUEUE_DEMO

config PACKAGE_WORK_QUEUE_DEMO_STACK_SIZE
	int "Work queue demo thread stack size (bytes)"
	default 1024
	help
	  Stack size used by both the dedicated workqueue thread and the
	  trigger thread.

config PACKAGE_WORK_QUEUE_DEMO_PRIORITY
	int "Work queue demo dedicated workqueue priority"
	default 7
	help
	  Zephyr thread priority for the dedicated workqueue thread
	  (lower number = higher priority).

config PACKAGE_WORK_QUEUE_DEMO_TRIGGER_PRIORITY
	int "Work queue demo trigger thread priority"
	default 8
	help
	  Zephyr thread priority for the thread that periodically submits the
	  one-shot work item.

config PACKAGE_WORK_QUEUE_DEMO_INIT_PRIORITY
	int "Work queue demo SYS_INIT priority"
	default 90
	help
	  SYS_INIT priority (APPLICATION level) used to start the dedicated
	  workqueue thread and the trigger thread during boot.

endif # PACKAGE_WORK_QUEUE_DEMO
```

## Example/nrf52833DK/hardware/package_key/Kconfig
```kconfig
config PACKAGE_KEY
	bool "Enable KEY hardware package"
	default n
	help
	  Enable the button/key GPIO driver package for nRF52833DK.
	  Provides key_register_callback() API for button event notification.
	  The module is auto-initialized via SYS_INIT at APPLICATION level.

if PACKAGE_KEY

config PACKAGE_KEY_INIT_PRIORITY
	int "KEY driver initialization priority"
	default 90
	help
	  Initialization priority for the KEY driver within APPLICATION level.

endif # PACKAGE_KEY
```

## Example/nrf52833DK/hardware/package_lcd_backlight/Kconfig
```kconfig
config PACKAGE_LCD_BACKLIGHT
	bool "Enable LCD backlight hardware package"
	default y
	depends on GPIO
	help
	  Enable the LCD backlight GPIO driver package for nRF52833DK.
	  Provides lcd_backlight_on(), lcd_backlight_off(), lcd_backlight_set()
	  APIs. The module is auto-initialized via SYS_INIT at APPLICATION level.
	  The GPIO (P0.31) drives an external MOSFET gate, not the backlight
	  LEDs directly.

if PACKAGE_LCD_BACKLIGHT

config PACKAGE_LCD_BACKLIGHT_INIT_PRIORITY
	int "LCD backlight driver initialization priority"
	default 90
	help
	  Initialization priority for the LCD backlight driver within
	  APPLICATION level.

endif # PACKAGE_LCD_BACKLIGHT
```

## Example/nrf52833DK/hardware/package_led/Kconfig
```kconfig
config PACKAGE_LED
	bool "Enable LED hardware package"
	default y
	help
	  Enable the LED GPIO driver package for nRF52833DK.
	  Provides led_on(), led_off(), led_toggle() APIs.
	  The module is auto-initialized via SYS_INIT at APPLICATION level.

if PACKAGE_LED

config PACKAGE_LED_INIT_PRIORITY
	int "LED driver initialization priority"
	default 90
	help
	  Initialization priority for the LED driver within APPLICATION level.

endif # PACKAGE_LED
```
