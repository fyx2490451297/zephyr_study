## CMakeLists.txt
```
# 指定最低 CMake 版本要求
cmake_minimum_required(VERSION 3.20.0)

# 寻找 Zephyr 系统 (自动引入所有的编译工具链和内核库)
find_package(Zephyr REQUIRED HINTS $ENV{ZEPHYR_BASE})

# 定义项目名称
project(Study00_HelloWorld)

# 添加你的源文件到 'app' 目标中
target_sources(app PRIVATE src/main.c)
```

## prj.conf
```kconfig
# 启用 printk 打印功能
CONFIG_PRINTK=y

# 启用日志功能
CONFIG_LOG=y
```

## src/main.c
```c
#include <zephyr/kernel.h>
#include <zephyr/logging/log.h>

LOG_MODULE_REGISTER(hello_world, LOG_LEVEL_INF);

int main(void)
{
    LOG_INF("Hello, World! Zephyr is running.");

    while (1) {
        /* 主线程循环，通过sleep让出CPU时间 */
        k_sleep(K_SECONDS(5));
    }
    return 0;
}
```
